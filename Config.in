## configs/2bignetv2_defconfig
```kconfig
BR2_arm=y
BR2_TARGET_GENERIC_HOSTNAME="2bignetv2"
BR2_TARGET_GENERIC_ISSUE="Welcome to Lacie 2 Big Network V2 NAS system"
BR2_SYSTEM_DHCP="eth0"
BR2_ROOTFS_OVERLAY="$(BR2_EXTERNAL_LACIE_PATH)/board/2bignetv2/rootfs_overlay"
BR2_LINUX_KERNEL=y
BR2_LINUX_KERNEL_DEFCONFIG="orion5x"
BR2_LINUX_KERNEL_DTS_SUPPORT=y
BR2_LINUX_KERNEL_INTREE_DTS_NAME="kirkwood-net2big"
BR2_PACKAGE_BUSYBOX_CONFIG="$(BR2_EXTERNAL_LACIE_PATH)/board/2bignetv2/busybox.config"
BR2_PACKAGE_UBOOT_TOOLS=y
BR2_PACKAGE_AVAHI=y
# BR2_PACKAGE_AVAHI_AUTOIPD is not set
BR2_PACKAGE_AVAHI_DAEMON=y
BR2_PACKAGE_DROPBEAR=y
BR2_PACKAGE_NETATALK=y
BR2_PACKAGE_NETPLUG=y
BR2_PACKAGE_NTP=y
BR2_PACKAGE_RSYNC=y
BR2_TARGET_ROOTFS_TAR_GZIP=y
```
